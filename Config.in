## Config.in
```kconfig
menuconfig RV_TARGET_RKMEDIA
    bool "[rv] media library"
    default y

if RV_TARGET_RKMEDIA

config RV_TARGET_RKMEDIA_MPP
    bool "rk mpp wrapper"
    select RV_TARGET_MPP
    help
      wrapped function of rk mpp

config RV_TARGET_RKMEDIA_OGG
    bool "ogg"
    select RV_TARGET_LIBVORBIS
    help
      wrapped function of ogg vorbis

if RV_TARGET_RKMEDIA_OGG

config RV_TARGET_RKMEDIA_OGGVORBIS_DEMUXER
    bool "ogg vorbis demuxer_decode"
    default y
    help
      wrapped function of libvorbisfile

config RV_TARGET_RKMEDIA_OGGVORBIS_MUXER
    bool "TODO: ogg vorbis encode_muxer"
    help
      wrapped function of libvorbisenc

endif

if RV_TARGET_ALSA_LIB

config RV_TARGET_RKMEDIA_ALSA_PLAYBACK
    bool "alsa playback"
    help
      wrapped function of alsa playback

config RV_TARGET_RKMEDIA_ALSA_CAPTURE
    bool "alsa capture"
    help
      wrapped function of alsa capture

endif

endif
```
